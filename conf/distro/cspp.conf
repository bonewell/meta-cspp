## conf/distro/cspp.conf
```bitbake
require conf/distro/poky.conf

DISTRO = "cspp"
DISTRO_NAME = "CSPP project"
DISTRO_VERSION = "1.0"

PACKAGE_CLASSES = "package_ipk"

PACKAGE_FEED_URIS = "http://127.0.0.1:8000"
```

## conf/layer.conf
```bitbake
# We have a conf and classes directory, add to BBPATH
BBPATH .= ":${LAYERDIR}"

# We have recipes-* directories, add to BBFILES
BBFILES += "${LAYERDIR}/recipes-*/*/*.bb \
	${LAYERDIR}/recipes-*/*/*.bbappend"

BBFILE_COLLECTIONS += "cspp"
BBFILE_PATTERN_cspp = "^${LAYERDIR}/"
BBFILE_PRIORITY_cspp = "6"
```
